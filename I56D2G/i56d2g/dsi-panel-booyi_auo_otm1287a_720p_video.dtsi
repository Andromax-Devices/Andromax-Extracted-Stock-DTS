/* Copyright (c) 2014, The Linux Foundation. All rights reserved.
 *
 * This program is free software; you can redistribute it and/or modify
 * it under the terms of the GNU General Public License version 2 and
 * only version 2 as published by the Free Software Foundation.
 *
 * This program is distributed in the hope that it will be useful,
 * but WITHOUT ANY WARRANTY; without even the implied warranty of
 * MERCHANTABILITY or FITNESS FOR A PARTICULAR PURPOSE.  See the
 * GNU General Public License for more details.
 */

&mdss_mdp {
	dsi_otm1287a_booyi_auo_720p_video: qcom,mdss_dsi_otm1287a_booyi_auo_720p_video {
		qcom,mdss-dsi-panel-name = "booyi auo otm1287a video 720p";
		qcom,mdss-dsi-panel-controller = <&mdss_dsi0>;
		qcom,mdss-dsi-panel-type = "dsi_video_mode";
		qcom,mdss-dsi-panel-destination = "display_1";
		qcom,mdss-dsi-panel-framerate = <60>;
		qcom,mdss-dsi-virtual-channel-id = <0>;
		qcom,mdss-dsi-stream = <0>;
		qcom,mdss-dsi-panel-width = <720>;
		qcom,mdss-dsi-panel-height = <1280>;
		qcom,mdss-pan-physical-width-dimension = <62>;
		qcom,mdss-pan-physical-height-dimension = <110>;
		qcom,mdss-dsi-h-front-porch = <80>;
		qcom,mdss-dsi-h-back-porch = <60>;
		qcom,mdss-dsi-h-pulse-width = <4>;
		qcom,mdss-dsi-h-sync-skew = <0>;
		qcom,mdss-dsi-v-back-porch = <10>;
		qcom,mdss-dsi-v-front-porch = <7>;
		qcom,mdss-dsi-v-pulse-width = <2>;
		qcom,mdss-dsi-h-left-border = <0>;
		qcom,mdss-dsi-h-right-border = <0>;
		qcom,mdss-dsi-v-top-border = <0>;
		qcom,mdss-dsi-v-bottom-border = <0>;
		qcom,mdss-dsi-bpp = <24>;
		qcom,mdss-dsi-underflow-color = <0xff>;
		qcom,mdss-dsi-border-color = <0>;
		qcom,mdss-dsi-on-command = [29 01 00 00 00 00 02 00 00 29 01 00 00 00 00 04 ff 12 87 01 29 01 00 00 00 00 02 00 80 29 01 00 00 00 00 03 ff 12 87 29 01 00 00 00 00 02 00 92 29 01 00 00 00 00 03 ff 30 02 29 01 00 00 00 00 02 00 80 29 01 00 00 00 00 0a c0 00 64 00 10 10 00 64 10 10 29 01 00 00 00 00 02 00 90 29 01 00 00 00 00 07 c0 00 5c 00 01 00 04 29 01 00 00 00 00 02 00 a2 29 01 00 00 00 00 04 c0 01 00 00 29 01 00 00 00 00 02 00 b3 29 01 00 00 00 00 03 c0 00 55 29 01 00 00 00 00 02 00 81 29 01 00 00 00 00 02 c1 55 29 01 00 00 00 00 02 00 a0 29 01 00 00 00 00 0f c4 05 10 04 02 05 15 11 05 10 07 02 05 15 11 29 01 00 00 00 00 02 00 b0 29 01 00 00 00 00 03 c4 00 00 29 01 00 00 00 00 02 00 91 29 01 00 00 00 00 03 c5 29 52 29 01 00 00 00 00 02 00 00 29 01 00 00 00 00 03 d8 94 94 29 01 00 00 00 00 02 00 00 29 01 00 00 00 00 02 d9 4b 29 01 00 00 00 00 02 00 b3 29 01 00 00 00 00 02 c5 84 29 01 00 00 00 00 02 00 bb 29 01 00 00 00 00 02 c5 8a 29 01 00 00 00 00 02 00 82 29 01 00 00 00 00 02 c4 0a 29 01 00 00 00 00 02 00 c6 29 01 00 00 00 00 02 b0 03 29 01 00 00 00 00 02 00 00 29 01 00 00 00 00 02 d0 40 29 01 00 00 00 00 02 00 00 29 01 00 00 00 00 03 d1 00 00 29 01 00 00 00 00 02 00 80 29 01 00 00 00 00 02 c4 00 29 01 00 00 00 00 02 00 98 29 01 00 00 00 00 02 c5 10 29 01 00 00 00 00 02 00 81 29 01 00 00 00 00 02 f5 15 29 01 00 00 00 00 02 00 83 29 01 00 00 00 00 02 f5 15 29 01 00 00 00 00 02 00 85 29 01 00 00 00 00 02 f5 15 29 01 00 00 00 00 02 00 87 29 01 00 00 00 00 02 f5 15 29 01 00 00 00 00 02 00 89 29 01 00 00 00 00 02 f5 15 29 01 00 00 00 00 02 00 8b 29 01 00 00 00 00 02 f5 15 29 01 00 00 00 00 02 00 95 29 01 00 00 00 00 02 f5 15 29 01 00 00 00 00 02 00 97 29 01 00 00 00 00 02 f5 15 29 01 00 00 00 00 02 00 99 29 01 00 00 00 00 02 f5 15 29 01 00 00 00 00 02 00 a1 29 01 00 00 00 00 02 f5 15 29 01 00 00 00 00 02 00 a3 29 01 00 00 00 00 02 f5 15 29 01 00 00 00 00 02 00 a5 29 01 00 00 00 00 02 f5 15 29 01 00 00 00 00 02 00 a7 29 01 00 00 00 00 02 f5 15 29 01 00 00 00 00 02 00 ab 29 01 00 00 00 00 02 f5 18 29 01 00 00 00 00 02 00 94 29 01 00 00 00 00 03 f5 00 00 29 01 00 00 00 00 02 00 d2 29 01 00 00 00 00 03 f5 06 15 29 01 00 00 00 00 02 00 b2 29 01 00 00 00 00 03 f5 00 00 29 01 00 00 00 00 02 00 b6 29 01 00 00 00 00 03 f5 00 00 29 01 00 00 00 00 02 00 b4 29 01 00 00 00 00 02 c5 cc 29 01 00 00 00 00 02 00 90 29 01 00 00 00 00 05 f5 02 11 02 15 29 01 00 00 00 00 02 00 90 29 01 00 00 00 00 02 c5 50 29 01 00 00 00 00 02 00 94 29 01 00 00 00 00 02 c5 77 29 01 00 00 00 00 02 00 80 29 01 00 00 00 00 0c cb 00 00 00 00 00 00 00 00 00 00 00 29 01 00 00 00 00 02 00 90 29 01 00 00 00 00 10 cb 00 00 00 00 00 00 00 00 00 00 00 ff 00 ff 00 29 01 00 00 00 00 02 00 a0 29 01 00 00 00 00 10 cb ff 00 ff 00 00 00 00 00 00 00 00 00 00 00 00 29 01 00 00 00 00 02 00 b0 29 01 00 00 00 00 10 cb 00 00 00 ff 00 ff 00 ff 00 ff 00 00 00 00 00 29 01 00 00 00 00 02 00 c0 29 01 00 00 00 00 10 cb 00 00 00 00 00 00 00 05 05 00 05 05 05 05 05 29 01 00 00 00 00 02 00 d0 29 01 00 00 00 00 10 cb 05 05 05 05 05 00 00 00 00 00 00 00 00 00 05 29 01 00 00 00 00 02 00 e0 29 01 00 00 00 00 0f cb 05 00 05 05 05 05 05 05 05 05 05 05 00 00 29 01 00 00 00 00 02 00 f0 29 01 00 00 00 00 0c cb ff ff ff ff ff ff ff ff ff ff ff 29 01 00 00 00 00 02 00 80 29 01 00 00 00 00 10 cc 00 00 00 00 00 00 00 05 07 00 11 15 13 17 0d 29 01 00 00 00 00 02 00 90 29 01 00 00 00 00 10 cc 09 0f 0b 01 03 00 00 00 00 00 00 00 00 00 06 29 01 00 00 00 00 02 00 a0 29 01 00 00 00 00 0f cc 08 00 12 16 14 18 0e 0a 10 0c 02 04 00 00 29 01 00 00 00 00 02 00 b0 29 01 00 00 00 00 10 cc 00 00 00 00 00 00 00 04 02 00 14 18 12 16 0c 29 01 00 00 00 00 02 00 c0 29 01 00 00 00 00 10 cc 10 0a 0e 08 06 00 00 00 00 00 00 00 00 00 03 29 01 00 00 00 00 02 00 d0 29 01 00 00 00 00 0f cc 01 00 13 17 11 15 0b 0f 09 0d 07 05 00 00 29 01 00 00 00 00 02 00 80 29 01 00 00 00 00 0d ce 87 03 28 86 03 28 85 03 28 84 03 28 29 01 00 00 00 00 02 00 90 29 01 00 00 00 00 0f ce 34 fc 28 34 fd 28 34 fe 28 34 ff 28 00 00 29 01 00 00 00 00 02 00 a0 29 01 00 00 00 00 0f ce 38 07 05 00 00 28 00 38 06 05 01 00 28 00 29 01 00 00 00 00 02 00 b0 29 01 00 00 00 00 0f ce 38 05 05 02 00 28 00 38 04 05 03 00 28 00 29 01 00 00 00 00 02 00 c0 29 01 00 00 00 00 0f ce 38 03 05 04 00 28 00 38 02 05 05 00 28 00 29 01 00 00 00 00 02 00 d0 29 01 00 00 00 00 0f ce 38 01 05 06 00 28 00 38 00 05 07 00 28 00 29 01 00 00 00 00 02 00 80 29 01 00 00 00 00 0f cf 38 07 05 00 00 18 25 38 06 05 01 00 18 25 29 01 00 00 00 00 02 00 90 29 01 00 00 00 00 0f cf 38 05 05 02 00 18 25 38 04 05 03 00 18 25 29 01 00 00 00 00 02 00 a0 29 01 00 00 00 00 0f cf 38 03 05 04 00 18 25 38 02 05 05 00 18 25 29 01 00 00 00 00 02 00 b0 29 01 00 00 00 00 0f cf 38 01 05 06 00 18 25 38 00 05 07 00 18 25 29 01 00 00 00 00 02 00 c0 29 01 00 00 00 00 0c cf 01 01 20 20 00 00 01 81 00 03 08 29 01 00 00 00 00 02 00 00 29 01 00 00 00 00 15 e1 04 19 36 4d 59 6d 6c 97 85 9e 67 54 67 45 46 39 2d 21 16 06 29 01 00 00 00 00 02 00 00 29 01 00 00 00 00 15 e2 04 19 36 4d 59 6d 6c 97 85 9e 67 54 67 45 46 39 2d 21 16 06 29 01 00 00 00 00 02 81 81 29 01 00 00 00 00 02 00 a0 29 01 00 00 00 00 0d d6 01 4d 01 4d 01 73 01 9a 01 9a 01 9a 29 01 00 00 00 00 02 00 b0 29 01 00 00 00 00 0d d6 01 9a 01 9a 01 9a 01 9a 01 9a 01 9a 29 01 00 00 00 00 02 00 c0 29 01 00 00 00 00 0d d6 4d 11 33 66 11 66 66 11 66 66 11 66 29 01 00 00 00 00 02 00 d0 29 01 00 00 00 00 07 d6 66 11 66 66 11 66 29 01 00 00 00 00 02 00 e0 29 01 00 00 00 00 0d d6 33 11 33 33 11 33 33 11 33 33 11 33 29 01 00 00 00 00 02 00 f0 29 01 00 00 00 00 07 d6 33 11 33 33 11 33 29 01 00 00 00 00 02 00 00 29 01 00 00 00 00 04 ff ff ff ff 05 01 00 00 78 00 02 11 00 05 01 00 00 14 00 02 29 00];
		qcom,mdss-dsi-off-command = [05 01 00 00 14 00 02 28 00 05 01 00 00 78 00 02 10 00];
		qcom,mdss-dsi-on-command-state = "dsi_lp_mode";
		qcom,mdss-dsi-off-command-state = "dsi_lp_mode";
		qcom,mdss-dsi-h-sync-pulse = <1>;
		qcom,mdss-dsi-traffic-mode = "burst_mode";
		qcom,mdss-dsi-lane-map = "lane_map_0123";
		qcom,mdss-dsi-bllp-eof-power-mode;
		qcom,mdss-dsi-bllp-power-mode;
		qcom,mdss-dsi-lane-0-state;
		qcom,mdss-dsi-lane-1-state;
		qcom,mdss-dsi-lane-2-state;
		qcom,mdss-dsi-lane-3-state;
		qcom,mdss-dsi-bl-min-level = <5>;
		qcom,mdss-dsi-bl-max-level = <255>;
		qcom,mdss-dsi-dma-trigger = "trigger_sw";
		qcom,mdss-dsi-mdp-trigger = "none";
		qcom,mdss-dsi-bl-pmic-control-type = "bl_ctrl_pwm";
		qcom,mdss-dsi-bl-pmic-pwm-frequency = <0x36>;
		qcom,mdss-dsi-bl-pmic-bank-select = <0x0>;
		qcom,mdss-dsi-pwm-gpio = <&pm8916_mpps 4 0x0>;
		qcom,mdss-dsi-reset-sequence = <0x1 0xa 0x0 0xa 0x1 0x14>;
		qcom,mdss-dsi-lp11-init;
		qcom,cont-splash-enabled;
	};
};
